## drivers/minos/Kconfig
```kconfig
menu "Minos"

config MINOS
	bool "Enable Minos Hypervisor driver"
	default y
	---help---
	  Enable support for Minos hyperviosr

if MINOS

config VIRTIO_CONSOLE_EARLY_PRINTK
	bool "early printk based on virtio console device"
	default y

endif

endmenu
```
